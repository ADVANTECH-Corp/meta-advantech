## meta-Edge-Sense/conf/layer.conf
```bitbake
# We have a conf and classes directory, add to BBPATH
BBPATH .= ":${LAYERDIR}"
BBFILES += "\
            ${LAYERDIR}/recipes-*/*/*.bb \
            ${LAYERDIR}/recipes-*/*/*.bbappend \
           "

BBFILE_COLLECTIONS += "advantech-edge"
BBFILE_PATTERN_advantech-edge = "^${LAYERDIR}/"
BBFILE_PRIORITY_advantech-edge = "10"

# do not error out on bbappends for missing recipes
BB_DANGLINGAPPENDS_WARNONLY = "true"

# Preferred Versions
PREFERRED_VERSION_nodejs = "6.10.3"
PREFERRED_VERSION_nodejs-native = "6.10.3"
```

## meta-WISE-PaaS/conf/layer.conf
```bitbake
# We have a conf and classes directory, add to BBPATH
BBPATH .= ":${LAYERDIR}"
BBFILES += "\
            ${LAYERDIR}/recipes-*/*/*.bb \
            ${LAYERDIR}/recipes-*/*/*.bbappend \
           "

BBFILE_COLLECTIONS += "advantech-addons"
BBFILE_PATTERN_advantech-addons = "^${LAYERDIR}/"
BBFILE_PRIORITY_advantech-addons = "6"
```

## meta-fsl-imx6/conf/layer.conf
```bitbake
# We have a conf and classes directory, add to BBPATH
BBPATH .= ":${LAYERDIR}"

# We have recipes-* directories, add to BBFILES
BBFILES += "${LAYERDIR}/recipes-*/*/*.bb \
	${LAYERDIR}/recipes-*/*/*.bbappend"

BBFILE_COLLECTIONS += "advantech"
BBFILE_PATTERN_advantech = "^${LAYERDIR}/"
BBFILE_PRIORITY_advantech = "6"

## this is needed for linux and uboot imx recipes
PREFERRED_VERSION_linux-imx_mx6 = "4.9.11"
PREFERRED_VERSION_u-boot-imx_mx6 = "2017.03"

## this is needed for lirc recipes
PREFERRED_VERSION_lirc = "0.9.0"
```

## meta-fsl-imx6/conf/machine/imx6dlrom5420b1.conf
```bitbake
#@TYPE: Machine
#@NAME: Freescale i.MX6DL SABRE Smart Device
#@SOC: i.MX6DL
#@DESCRIPTION: Machine configuration for Freescale i.MX6DL SABRE Smart Device

require conf/machine/include/imx6sabresd-common.inc
require conf/machine/include/advantech-default-settings.inc

SOC_FAMILY = "mx6:mx6dl"

KERNEL_DEVICETREE = "imx6dl-rom5420-b1.dtb"

KERNEL_IMAGETYPE = "zImage"

UBOOT_CONFIG ??= "2G 1G 512M"
UBOOT_CONFIG[512M] = "mx6solorom5420b1_512M_config,sdcard"
UBOOT_CONFIG[1G] = "mx6solorom5420b1_1G_config,sdcard"
UBOOT_CONFIG[2G] = "mx6dlrom5420b1_2G_config,sdcard"

# build all vpu firmware packages into the image
MACHINE_FIRMWARE_append_mx6 = " firmware-imx-vpu-imx6q firmware-imx-vpu-imx6d"
```

## meta-fsl-imx6/conf/machine/imx6dlrom7421a1.conf
```bitbake
#@TYPE: Machine
#@NAME: Freescale i.MX6DL SABRE Smart Device
#@SOC: i.MX6DL
#@DESCRIPTION: Machine configuration for Freescale i.MX6DL SABRE Smart Device

require conf/machine/include/imx6sabresd-common.inc
require conf/machine/include/advantech-default-settings.inc

SOC_FAMILY = "mx6:mx6dl"

KERNEL_DEVICETREE = "imx6dl-rom7421-a1.dtb"

KERNEL_IMAGETYPE = "zImage"

UBOOT_CONFIG ??= "1G 512M"
UBOOT_CONFIG[512M] = "mx6solorom7421a1_512M_config,sdcard"
UBOOT_CONFIG[1G] = "mx6solorom7421a1_1G_config,sdcard"

# build all vpu firmware packages into the image
MACHINE_FIRMWARE_append_mx6 = " firmware-imx-vpu-imx6q firmware-imx-vpu-imx6d"
```

## meta-fsl-imx6/conf/machine/imx6qebcjf02a1.conf
```bitbake
#@TYPE: Machine
#@NAME: Freescale i.MX6Q SABRE Smart Device
#@SOC: i.MX6Q
#@DESCRIPTION: Machine configuration for Freescale i.MX6Q SABRE Smart Device

require conf/machine/include/imx6sabresd-common.inc
require conf/machine/include/advantech-default-settings.inc

SOC_FAMILY = "mx6:mx6q"

KERNEL_DEVICETREE = "imx6q-ebcjf02-a1.dtb"

KERNEL_IMAGETYPE = "zImage"

UBOOT_CONFIG ??= "1G"
UBOOT_CONFIG[1G] = "mx6qebcjf02a1_1G_config,sdcard"

# build all vpu firmware packages into the image
MACHINE_FIRMWARE_append_mx6 = " firmware-imx-vpu-imx6q firmware-imx-vpu-imx6d"
```

## meta-fsl-imx6/conf/machine/imx6qebcrs03a1.conf
```bitbake
#@TYPE: Machine
#@NAME: Freescale i.MX6DL SABRE Smart Device
#@SOC: i.MX6DL
#@DESCRIPTION: Machine configuration for Freescale i.MX6DL SABRE Smart Device

require conf/machine/include/imx6sabresd-common.inc
require conf/machine/include/advantech-default-settings.inc

SOC_FAMILY = "mx6:mx6q"

KERNEL_DEVICETREE = "imx6q-ebcrs03-a1.dtb"

KERNEL_IMAGETYPE = "zImage"

UBOOT_CONFIG ??= "2G"
UBOOT_CONFIG[2G] = "mx6qebcrs03a1_2G_config,sdcard"

# build all vpu firmware packages into the image
MACHINE_FIRMWARE_append_mx6 = " firmware-imx-vpu-imx6q firmware-imx-vpu-imx6d"
```

## meta-fsl-imx6/conf/machine/imx6qrom3420a1.conf
```bitbake
#@TYPE: Machine
#@NAME: NXP i.MX6Q SABRE Smart Device
#@SOC: i.MX6Q
#@DESCRIPTION: Machine configuration for NXP i.MX6Q SABRE Smart Device

MACHINEOVERRIDES =. "mx6:mx6q:"

require conf/machine/include/imx6sabresd-common.inc
require conf/machine/include/advantech-default-settings.inc

KERNEL_DEVICETREE = "imx6q-rom3420-a1.dtb"

KERNEL_IMAGETYPE = "zImage"

UBOOT_CONFIG ??= "2G 1G"
UBOOT_CONFIG[1G] = "mx6qrom3420a1_1G_config,sdcard"
UBOOT_CONFIG[2G] = "mx6qrom3420a1_2G_config,sdcard"

# build all vpu firmware packages into the image
MACHINE_FIRMWARE_append_mx6 = " firmware-imx-vpu-imx6q firmware-imx-vpu-imx6d"
```

## meta-fsl-imx6/conf/machine/imx6qrsb6410a2.conf
```bitbake
#@TYPE: Machine
#@NAME: Freescale i.MX6Q SABRE Smart Device
#@SOC: i.MX6Q
#@DESCRIPTION: Machine configuration for Freescale i.MX6Q SABRE Smart Device

require conf/machine/include/imx6sabresd-common.inc
require conf/machine/include/advantech-default-settings.inc

SOC_FAMILY = "mx6:mx6q"

KERNEL_DEVICETREE = "imx6q-rsb6410-a2.dtb"

KERNEL_IMAGETYPE = "zImage"

UBOOT_CONFIG ??= "2G 1G"
UBOOT_CONFIG[1G] = "mx6qrsb6410a2_1G_config,sdcard"
UBOOT_CONFIG[2G] = "mx6qrsb6410a2_2G_config,sdcard"

# build all vpu firmware packages into the image
MACHINE_FIRMWARE_append_mx6 = " firmware-imx-vpu-imx6q firmware-imx-vpu-imx6d"
```

## meta-fsl-imx6/conf/machine/imx7debcrm01a1.conf
```bitbake
#@TYPE: Machine
#@NAME: Freescale i.MX7D SABRE Smart Device
#@SOC: i.MX7D
#@DESCRIPTION: Machine configuration for Freescale i.MX7D SABRE Smart Device
#@MAINTAINER: Lauren Post <Lauren.Post@nxp.com>

require conf/machine/include/imx-base.inc
require conf/machine/include/tune-cortexa7.inc
require conf/machine/include/advantech-default-settings.inc

MACHINE_FEATURES += " pci wifi bluetooth"

SOC_FAMILY = "mx7:mx7d"

KERNEL_DEVICETREE = "imx7d-ebcrm01-a1.dtb"

UBOOT_CONFIG ??= "2G_IM"
UBOOT_CONFIG[2G_IM] = "mx7debcrm01a1_2G_IM_config,sdcard"
UBOOT_CONFIG[2G_MT] = "mx7debcrm01a1_2G_MT_config,sdcard"

XSERVER += "mesa-driver-swrast"

# Install brcm firmware
MACHINE_FIRMWARE_append = " firmware-imx-brcm"
```

## meta-fsl-imx6/meta-gateway/meta-advantech-addons/conf/layer.conf
```bitbake
# We have a conf and classes directory, add to BBPATH
BBPATH .= ":${LAYERDIR}"

# We have recipes-* directories, add to BBFILES
BBFILES += "${LAYERDIR}/recipes-*/*/*.bb \
        ${LAYERDIR}/recipes-*/*/*.bbappend"

BBFILE_COLLECTIONS += "advantech-addons"
BBFILE_PATTERN_advantech-addons = "^${LAYERDIR}/"
BBFILE_PRIORITY_advantech-addons = "6"
```

## meta-fsl-imx8/conf/machine/imx8qmrom7720a1.conf
```bitbake
#@TYPE: Machine
#@NAME: i.MX 8QM LPDDR4 ARM2
#@DESCRIPTION: i.MX 8QuadMax LPDDR4 ARM2 Development board
#@MAINTAINER: Lauren Post <lauren.post@nxp.com>

require conf/machine/include/arm/arch-arm64.inc
require conf/machine/include/imx-base.inc
require conf/machine/include/advantech-default-settings.inc

MACHINEOVERRIDES =. "mx8:mx8qm:"

# Don't include kernels in standard images
RDEPENDS_kernel-base = ""

LOADADDR = ""

# We have to disable SERIAL_CONSOLE due to auto-serial-console
SERIAL_CONSOLE = "115200 ttyAMA0"

# we do not want to have getty running on tty1 as we run
# auto-serial-console there
USE_VT = "0"

KERNEL_DEVICETREE = "freescale/imx8qm-rom7720-a1.dtb"

UBOOT_MAKE_TARGET = "u-boot.bin"
UBOOT_SUFFIX = "bin"
UBOOT_CONFIG ??= "6G"
UBOOT_CONFIG[6G] = "mx8qmrom7720a1_6G_config,sdcard"
UBOOT_CONFIG[fspi] = "mx8qmrom7720a1_6G_fspi_config"
UBOOT_CONFIG[mfgtool] = "mx8qmrom7720a1_6G_config"

BOOT_SPACE = "32768"
IMAGE_BOOTLOADER = "imx-boot"
IMX_BOOT_SEEK = "33"

IMAGE_BOOTFIRMWARE = "firmware-imx"
IMAGE_BOOTFILES += "hdmitxfw.bin dpfw.bin"

BOARD_TYPE = "val"

MACHINEOVERRIDES =. "imx:"
```

## meta-qcom-410c/conf/layer.conf
```bitbake
BBPATH .= ":${LAYERDIR}"
BBFILES += "\
            ${LAYERDIR}/recipes-*/*/*.bb \
            ${LAYERDIR}/recipes-*/*/*.bbappend \
           "

BBFILE_COLLECTIONS += "advantech-qcom"
BBFILE_PATTERN_advantech-qcom := "^${LAYERDIR}/"
BBFILE_PRIORITY_advantech-qcom = "4"

# For firmware-qcom-dragonboard410c package
MACHINEOVERRIDES =. "dragonboard-410c:${MACHINE}"
ACCEPT_EULA_dragonboard-410c = "1"
```

## meta-qcom-410c/conf/machine/epc-r4761.conf
```bitbake
#@TYPE: Machine
#@NAME: epc-r4761
#@DESCRIPTION: Machine configuration for the EPC-R4761, with Qualcomm Snapdragon 410 APQ8016.

require conf/machine/include/qcom-apq8016.inc
require conf/machine/include/arm/arch-armv8.inc

MACHINE_FEATURES = "usbhost usbgadget alsa screen wifi bluetooth ext2"

KERNEL_IMAGETYPE = "Image"
KERNEL_DEVICETREE = "qcom/epc-r4761.dtb"

SERIAL_CONSOLE = "115200 ttyMSM0"

MACHINE_ESSENTIAL_EXTRA_RRECOMMENDS += " \
    kernel-modules \
    ${@bb.utils.contains('DISTRO_FEATURES', 'opengl', 'mesa-driver-msm', '', d)} \
    ${@bb.utils.contains('DISTRO_FEATURES', 'wifi', 'wcnss-config wcnss-start', '', d)} \
    ${@bb.utils.contains('DISTRO_FEATURES', 'bluez5', 'bluez5-noinst-tools', '', d)} \
    ${@'firmware-qcom-dragonboard410c' if d.getVar('ACCEPT_EULA_epc-r4761', True) == '1' else ''} \
"

QCOM_BOOTIMG_ROOTFS ?= "mmcblk0p13"
```

## meta-qcom-410c/conf/machine/rsb4760.conf
```bitbake
require conf/machine/dragonboard-410c.conf

KERNEL_DEVICETREE = "qcom/rsb4760.dtb"
```

## meta-ti-57xx/conf/layer.conf
```bitbake
# We have a conf and classes directory, append to BBPATH
BBPATH .= ":${LAYERDIR}"

# We have a recipes directory, add to BBFILES
BBFILES += "${LAYERDIR}/recipes*/*/*.bb ${LAYERDIR}/recipes*/*/*.bbappend"

BBFILE_COLLECTIONS += "meta-advantech"
BBFILE_PATTERN_meta-advantech := "^${LAYERDIR}/"
BBFILE_PRIORITY_meta-advantech = "16"

## this is needed for linux and uboot recipes
PREFERRED_VERSION_linux-processor-sdk = "4.4%"
PREFERRED_VERSION_u-boot-ti-staging = "2016.05%"
```

## meta-ti-57xx/conf/machine/include/ti-image-adv.inc
```bitbake
IMAGE_INSTALL += "\
    linux-firmware-sd8897 "

IMAGE_INSTALL += "\
   sqlite3 lua uci \
   curl curl-dev libxml2 libxml2-dev openssl openssl-dev lsb \
   mosquitto mosquitto-dev libdmclient libdmclient-dev \
   packagegroup-sdk-target "

IMAGE_INSTALL += "\
   rmm susi4 susi-iot  ota-script"

IMAGE_INSTALL += "\
   packagegroup-tools-bluetooth"

IMAGE_INSTALL += "\
   ppp"
```

## meta-ti-adv/conf/machine/am335xrom3310a1.conf
```bitbake
#@TYPE: Machine
#@NAME: AM335x EVM
#@DESCRIPTION: Machine configuration for the TI AM335x EVM

require conf/machine/include/ti33x.inc
require conf/machine/include/ti-image-am335x.inc

DTB_FILTER_am335xrom3310a1 = "${DTB_FILTER_ti33x}"

# Use built-in LCD by default
XSERVER += "xf86-input-tslib"
MACHINE_GUI_CLASS = "smallscreen"
MACHINE_FEATURES += "touchscreen"

IMAGE_FSTYPES += "ubifs ubi tar.xz"

SERIAL_CONSOLE = ""
SERIAL_CONSOLES = "115200;ttyS0 115200;ttyO0 115200"
SERIAL_CONSOLES_CHECK = "${SERIAL_CONSOLES}"

UBOOT_MACHINE = "am335x_rom3310a1_512M_defconfig"
KERNEL_DEVICETREE_am335xrom3310a1 =" am335x-rom3310a1.dtb"

# UBI information.  Note that this is board and kernel specific.  Changes
# in your kernel port may require changes in these variables.  For more
# details about this board please see
# http://processors.wiki.ti.com/index.php/UBIFS_Support

# do ubiattach /dev/ubi_ctrl -m 7 -O 2048
# From dmesg:
# UBI: smallest flash I/O unit:    2048
# UBI: logical eraseblock size:    126976 bytes
# from ubiattach stdout:
# UBI device number 0, total 1988 LEBs
MKUBIFS_ARGS = "-F -m 2048 -e 126976 -c 6100"

# do ubiattach /dev/ubi_ctrl -m 7 -O 2048
# from dmesg:
# UBI: smallest flash I/O unit:    2048
# UBI: physical eraseblock size:   131072 bytes (128 KiB)
# UBI: sub-page size:              512
# UBI: VID header offset:          2048 (aligned 2048)
UBINIZE_ARGS = "-m 2048 -p 128KiB -s 512 -O 2048"

MACHINE_FEATURES_remove = "sgx"
PACKAGECONFIG_remove = "wayland-egl"

IMAGE_INSTALL_remove = "chromium-wayland"
BBMASK="meta-browser/recipes-browser/chromium/chromium-wayland_53.0.2785.143.bb meta-arago/meta-arago-distro/recipes-graphics/wayland/wayland-ivi-extension_1.11.0.bb"

MULTIMEDIA_remove_ti33x = "chromium-wayland"
GRAPHICS_WESTON_remove = "wayland-ivi-extension"
```

## meta-ti-adv/conf/machine/am335xrsb4221a1.conf
```bitbake
#@TYPE: Machine
#@NAME: AM335x EVM
#@DESCRIPTION: Machine configuration for the TI AM335x EVM

require conf/machine/include/ti33x.inc
require conf/machine/include/ti-image-335x.inc

DTB_FILTER_am335xrsb4221a1 = "${DTB_FILTER_ti33x}"

# Use built-in LCD by default
XSERVER += "xf86-input-tslib"
MACHINE_GUI_CLASS = "smallscreen"
MACHINE_FEATURES += "touchscreen"

IMAGE_FSTYPES += "ubifs ubi tar.xz"

SERIAL_CONSOLE = ""
SERIAL_CONSOLES = "115200;ttyS0 115200;ttyO0 115200"
SERIAL_CONSOLES_CHECK = "${SERIAL_CONSOLES}"

UBOOT_MACHINE = "am335x_rsb4221a1_1G_config"
KERNEL_DEVICETREE_am335xrsb4221a1="am335x-rsb4221a1.dtb"

# UBI information.  Note that this is board and kernel specific.  Changes
# in your kernel port may require changes in these variables.  For more
# details about this board please see
# http://processors.wiki.ti.com/index.php/UBIFS_Support

# do ubiattach /dev/ubi_ctrl -m 7 -O 2048
# From dmesg:
# UBI: smallest flash I/O unit:    2048
# UBI: logical eraseblock size:    126976 bytes
# from ubiattach stdout:
# UBI device number 0, total 1988 LEBs
MKUBIFS_ARGS = "-F -m 2048 -e 126976 -c 6100"

# do ubiattach /dev/ubi_ctrl -m 7 -O 2048
# from dmesg:
# UBI: smallest flash I/O unit:    2048
# UBI: physical eraseblock size:   131072 bytes (128 KiB)
# UBI: sub-page size:              512
# UBI: VID header offset:          2048 (aligned 2048)
UBINIZE_ARGS = "-m 2048 -p 128KiB -s 512 -O 2048"
```

## meta-ti-adv/conf/machine/include/ti-image-335x.inc
```bitbake
IMAGE_INSTALL += "\
    linux-firmware-bcm43241b4 "

IMAGE_INSTALL += "\
   sqlite3 lua uci \
   curl curl-dev libxml2 libxml2-dev openssl openssl-dev lsb \
   mosquitto mosquitto-dev libdmclient libdmclient-dev \
   packagegroup-sdk-target "

IMAGE_INSTALL += "\
    ota-rmm ota-script rmm susi4 susi-iot "
#   ota-rmm rmm susi4 susi-iot  ota-script "

IMAGE_INSTALL += "\
   ppp"

IMAGE_INSTALL += "\
   libcap-ng libcap"


IMAGE_INSTALL += "\
   autoconf autoconf-archive"

IMAGE_INSTALL += "\
   packagegroup-tools-bluetooth"

IMAGE_INSTALL += "\
   openobex obexd"
```

## meta-ti-adv/conf/machine/include/ti-image-am335x.inc
```bitbake
IMAGE_INSTALL += "\
   linux-firmware-sd8897 linux-firmware-bcm43241b4 linux-firmware-ewm"

IMAGE_INSTALL += "\
   ppp"

IMAGE_INSTALL += "\
   libcap-ng libcap"

IMAGE_INSTALL += "\
   autoconf autoconf-archive"

IMAGE_INSTALL += "\
   packagegroup-tools-bluetooth"

IMAGE_INSTALL += "\
   openobex obexd"
```
